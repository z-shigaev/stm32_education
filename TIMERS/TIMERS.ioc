# file: TIMERS.ioc
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Mcu.Family=STM32F3
RCC.CortexFreq_Value=10000000
RCC.SYSCLKSourceVirtual=RCC_SYSCLKSOURCE_PLLCLK
ProjectManager.StackSize=0x400
ProjectManager.TargetToolchain=STM32CubeIDE
RCC.HCLKFreq_Value=10000000
RCC.APB2TimFreq_Value=10000000
RCC.USBFreq_Value=20000000
RCC.LSE_VALUE=32768
RCC.AHBFreq_Value=10000000
RCC.HSE_VALUE=8000000
board=custom
RCC.PLLMUL=RCC_PLL_MUL5
RCC.APB2Freq_Value=10000000
RCC.AHBCLKDivider=RCC_SYSCLK_DIV2
Mcu.Name=STM32F303V(B-C)Tx
RCC.SYSCLKFreq_VALUE=20000000
Mcu.Package=LQFP100
ProjectManager.HeapSize=0x200
RCC.HSI_VALUE=8000000
NVIC.PriorityGroup=NVIC_PRIORITYGROUP_4
RCC.APB1TimFreq_Value=10000000
RCC.APB1Freq_Value=10000000

// file: Core/Src/main.c
/* USER CODE BEGIN Header */
/**
  ******************************************************************************
  * @file           : main.c
  * @brief          : Main program body
  ******************************************************************************
  * @attention
  *
  * <h2><center>&copy; Copyright (c) 2023 STMicroelectronics.
  * All rights reserved.</center></h2>
  *
  * This software component is licensed by ST under BSD 3-Clause license,
  * the "License"; You may not use this file except in compliance with the
  * License. You may obtain a copy of the License at:
  *                        opensource.org/licenses/BSD-3-Clause
  *
  ******************************************************************************
  */
/* USER CODE END Header */
#include "main.h"

/* USER CODE BEGIN Includes */
#include <gpio_ctrl.h>
#include <button.h>
#include <timer.h>
/* USER CODE END Includes */

void SystemClock_Config(void);

int main(void)
{

  /* MCU Configuration--------------------------------------------------------*/

  /* Reset of all peripherals, Initializes the Flash interface and the Systick. */
  HAL_Init();

  /* USER CODE BEGIN Init */
  RCC->AHBENR |= RCC_AHBENR_GPIOEEN;
  RCC->AHBENR |= RCC_AHBENR_GPIOAEN;
  RCC->APB1ENR |= RCC_APB1ENR_TIM6EN;
  RCC->APB1ENR |= RCC_APB1ENR_TIM7EN;
  gpio_init(GPIOE, 8);
  gpio_init(GPIOE, 9);
  gpio_init(GPIOE, 10);
  gpio_init(GPIOE, 11);
  gpio_init(GPIOE, 12);
  gpio_init(GPIOE, 13);
  gpio_init(GPIOE, 14);
  gpio_init(GPIOE, 15);
  button_init();

  NVIC_EnableIRQ(TIM6_DAC_IRQn);
  NVIC_EnableIRQ(TIM7_IRQn);
  timer_init(TIM6, TIM_IRQ_ENABLE);		// инициализация таймера 6 с разрешением прерываний
  timer_init(TIM7, TIM_IRQ_ENABLE);		// инициализация таймера 7 с разрешением прерываний
  timer_set_up_period(TIM6, 5000);		// установка периода 5000 мс

  /* USER CODE END Init */

  /* Configure the system clock */
  SystemClock_Config();

  /* Initialize all configured peripherals */

  /* Infinite loop */
  /* USER CODE BEGIN WHILE */
  uint8_t flag = 0x1;
  while (1)
  {
    /* USER CODE END WHILE */
	  gpio_set(GPIOE, 8, flag);
	  delay(1e6);
	  flag ^= (0x1);
  }
}

void SystemClock_Config(void)
{
  RCC_OscInitTypeDef RCC_OscInitStruct = {0};
  RCC_ClkInitTypeDef RCC_ClkInitStruct = {0};

  /** Initializes the RCC Oscillators according to the specified parameters
  * in the RCC_OscInitTypeDef structure.
  */
  RCC_OscInitStruct.OscillatorType = RCC_OSCILLATORTYPE_HSI;
  RCC_OscInitStruct.HSIState = RCC_HSI_ON;
  RCC_OscInitStruct.HSICalibrationValue = RCC_HSICALIBRATION_DEFAULT;
  RCC_OscInitStruct.PLL.PLLState = RCC_PLL_ON;
  RCC_OscInitStruct.PLL.PLLSource = RCC_PLLSOURCE_HSI;
  RCC_OscInitStruct.PLL.PLLMUL = RCC_PLL_MUL5;
  if (HAL_RCC_OscConfig(&RCC_OscInitStruct) != HAL_OK)
  {
    Error_Handler();
  }
  /** Initializes the CPU, AHB and APB buses clocks
  */
  RCC_ClkInitStruct.ClockType = RCC_CLOCKTYPE_HCLK|RCC_CLOCKTYPE_SYSCLK
                              |RCC_CLOCKTYPE_PCLK1|RCC_CLOCKTYPE_PCLK2;
  RCC_ClkInitStruct.SYSCLKSource = RCC_SYSCLKSOURCE_PLLCLK;
  RCC_ClkInitStruct.AHBCLKDivider = RCC_SYSCLK_DIV2;
  RCC_ClkInitStruct.APB1CLKDivider = RCC_HCLK_DIV1;
  RCC_ClkInitStruct.APB2CLKDivider = RCC_HCLK_DIV1;

  if (HAL_RCC_ClockConfig(&RCC_ClkInitStruct, FLASH_LATENCY_0) != HAL_OK)
  {
    Error_Handler();
  }
}

void Error_Handler(void)
{
  __disable_irq();
  while (1)
  {
  }
}

/************************ (C) COPYRIGHT STMicroelectronics *****END OF FILE****/
